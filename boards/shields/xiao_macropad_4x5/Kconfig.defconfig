## boards/shields/xiao_macropad_4x5/Kconfig.defconfig
```kconfig
if SHIELD_XIAO_MACROPAD_4X5

config ZMK_KEYBOARD_NAME
    default "Xiao Pad 4x5"

endif
```

## boards/shields/xiao_macropad_4x5/Kconfig.shield
```kconfig
config SHIELD_XIAO_MACROPAD_4X5
    def_bool $(shields_list_contains,xiao_macropad_4x5)
```

## config/boards/shields/square_macro/Kconfig.defconfig
```kconfig
if SHIELD_SQUARE_MACRO
  config ZMK_KEYBOARD_NAME
  default "Square_macro"
endif
```
